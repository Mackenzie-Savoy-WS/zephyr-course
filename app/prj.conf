## CMakeLists.txt
```
cmake_minimum_required(VERSION 3.20.0)
list(APPEND BOARD_ROOT ${CMAKE_CURRENT_SOURCE_DIR}/../)
list(APPEND DTS_ROOT ${CMAKE_CURRENT_SOURCE_DIR}/..)

find_package(Zephyr REQUIRED)
project(my_zephyr_app)

target_sources(app PRIVATE src/main.cpp)    
add_subdirectory(drivers/our_driver)
```

## Kconfig
```
config APP_HEARTBEAT_PERIOD_MS
    int "Heartbeat period (ms)"
    range 100 10000
    default 500
    
menuconfig LED_SUBSYSTEM
    bool "LED Subsystem"

if LED_SUBSYSTEM

    choice
        prompt "LED blink sleep time"
        default LED_SLEEP_TIME_1000MS
        config LED_SLEEP_TIME_250MS
            bool "250ms (fastest)"
        config LED_SLEEP_TIME_500MS
            bool "500ms (fast)"
        config LED_SLEEP_TIME_1000MS
            bool "1s (medium)"
        config LED_SLEEP_TIME_2000MS
            bool "2s (slow)"
    endchoice

    # Hidden INT
    config BLINK_TIME_MS
        int
        default 250 if LED_SLEEP_TIME_250MS
        default 500 if LED_SLEEP_TIME_500MS
        default 1000 if LED_SLEEP_TIME_1000MS
        default 2000 if LED_SLEEP_TIME_2000MS
        default 0

    menuconfig ADVANCED_LED_SETTINGS
        bool "Advanced LED Settings"
        depends on LED_SUBSYSTEM
        if ADVANCED_LED_SETTINGS
            config LED_BRIGHTNESS
                int "LED Brightness (0-100)"
                range 0 100
                default 100

            config LED_FADE_DURATION
                int "LED Fade Duration (ms)"
                range 0 5000
                default 500
            menu "Expert Settings"
                visible if ADVANCED_LED_SETTINGS
                config LED_DEBUG_ENABLED
                    bool "Enable LED Debugging"
                    default n
                config LED_CUSTOM_PATTERN
                    bool "Custom LED Blink Pattern"
                    default n
            endmenu
        endif

endif # LED_SUBSYSTEM

source "Kconfig.zephyr"
rsource "drivers/our_driver/Kconfig"
```

## prj.conf
```kconfig
CONFIG_GPIO=y
CONFIG_LOG=y
CONFIG_LED_SUBSYSTEM=y
CONFIG_OUR_DRIVER=y
CONFIG_SHELL=y
```

## app.overlay
```dts
/ {
	our_driver0: our_driver {
		compatible = "our,driver";
		led = <&yellow_led>;
		status = "okay";
	};
	our_driver1: our_driver1 {
		compatible = "our,driver";
		led = <&red_led>;
		status = "okay";
	};

	aliases {
		app-led = &green_led;
		};
};
```

## src/main.cpp
```c
#include <zephyr/drivers/gpio.h>
#include <zephyr/kernel.h>
#include <zephyr/logging/log.h>
#include <zephyr/drivers/sensor.h>
#include <our_driver.h>

/* The devicetree node identifiers for the on board leds */
#define LED_NODE_G DT_ALIAS(app_led)


static const struct gpio_dt_spec ledg = GPIO_DT_SPEC_GET(LED_NODE_G, gpios);


LOG_MODULE_REGISTER(main, LOG_LEVEL_INF);


int main(void)
{
    const struct device *dev = DEVICE_DT_GET(DT_NODELABEL(our_driver0));
    const struct device *dev1 = DEVICE_DT_GET(DT_NODELABEL(our_driver1));
    struct sensor_value val;
    struct sensor_value val1;
    bool led_state = true;
    bool led_enabled = true;
    int beat_count = 0;
    
    // LED green for heartbeat
    if ((!gpio_is_ready_dt(&ledg)))
        return 0;
    
    if ((gpio_pin_configure_dt(&ledg, GPIO_OUTPUT_ACTIVE) < 0))
        return 0;
    
    // LED yellow via driver
    if(!device_is_ready(dev)) {
        LOG_INF("Our driver device not ready");
        return 0;
    }

    // LED red via driver
    if(!device_is_ready(dev1)) {
        LOG_INF("Our driver device not ready");
        return 0;
    }
    
    while (1) {
        // Disable for l7 task 2
        // Every 10 heartbeats LED-enabled flag
        /*if (beat_count++ % 10 == 0) {
            led_enabled = !led_enabled;
            our_driver_set_led_enabled(dev, led_enabled);
            our_driver_set_led_enabled(dev1, !led_enabled);
        }

        if ((gpio_pin_toggle_dt(&ledg) < 0))  
            return 0;

        led_state = !led_state;
        
        LOG_INF("LED Green state: %s", led_state ? "ON" : "OFF");

        if(!led_state){
            sensor_sample_fetch(dev);
            sensor_sample_fetch(dev1);
        } else {
            sensor_channel_get(dev, SENSOR_CHAN_ALL, &val);
            sensor_channel_get(dev1, SENSOR_CHAN_ALL, &val1);
        }*/
        
        k_msleep(CONFIG_APP_HEARTBEAT_PERIOD_MS); 
    }
    return 0;
}
```
