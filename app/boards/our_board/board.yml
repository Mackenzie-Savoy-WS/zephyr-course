## app/boards/our_board/board.yml
```yaml
board:
  name: our_board
  full_name: Our Board
  vendor: Mackenzie
  socs:
    - name: stm32h7s3xx
```

## app/drivers/our_driver/Kconfig
```kconfig
config OUR_DRIVER
    bool "Our driver"
    default y
    depends on DT_HAS_OUR_DRIVER_ENABLED
    select GPIO
    select SENSOR
```

## boards/my_board/Kconfig.defconfig
```kconfig
if BOARD_MY_BOARD

config BOARD_EARLY_INIT_HOOK
	default y

config BOARD_LATE_INIT_HOOK
	default y

endif # BOARD_MY_BOARD
```

## boards/my_board/board.yml
```yaml
board:
  name: my_board
  full_name: My Board
  vendor: st
  socs:
    - name: stm32h7s3xx
```

## boards/my_board/my_board_defconfig
```kconfig
# Disable SMPS
CONFIG_POWER_SUPPLY_DIRECT_SMPS=n

# Enable UART driver
CONFIG_SERIAL=y

# Enable console
CONFIG_CONSOLE=y
CONFIG_UART_CONSOLE=y

# Enable GPIO
CONFIG_GPIO=y
```

## dts/bindings/our,driver.yaml
```yaml
description: Our simple GPIO Driver
compatible: our,driver
include: base.yaml

properties:
  led:
    description: The GPIO pin for the LED
    type: phandle
    required: true
```
